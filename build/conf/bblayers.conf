## build/conf/bblayers.conf
```bitbake
# POKY_BBLAYERS_CONF_VERSION is increased each time build/conf/bblayers.conf
# changes incompatibly
POKY_BBLAYERS_CONF_VERSION = "2"

BBPATH = "${TOPDIR}"
BBFILES ?= ""

BBLAYERS ?= " \
  /home/sandesh/workspace/xilinx-yocto/poky/meta \
  /home/sandesh/workspace/xilinx-yocto/poky/meta-poky \
  /home/sandesh/workspace/xilinx-yocto/poky/meta-yocto-bsp \
  /home/sandesh/workspace/xilinx-yocto/meta-xilinx/meta-xilinx-contrib \
  /home/sandesh/workspace/xilinx-yocto/meta-xilinx/meta-xilinx-bsp \
  "
```
